AUTOSAR XML (schema 00046)
ar packages SWC_EABS_Package
  sensor actuator sw component type LidarSensor_SWC1
  sensor actuator sw component type SpeedSensor_SWC2
  ecu abstraction sw component type IOAbstraction_SWC3
  application sw component type AutoBrakeSystem_SWC4
  sensor actuator sw component type WarningLED_SWC5
  parameter sw component type DistanceValues_SWC6
  complex device driver sw component type BrakingSystem_SWC7
  service sw component type DiagMang_SWC8
  nv block sw component type NVM_SWC9
