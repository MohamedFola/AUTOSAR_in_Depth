AUTOSAR XML (schema 00046)
package /Interfaces_lab
  sender receiver interface SRI1: is-service=0
    data V1: sw-impl-policy=QUEUED, type=uint32, init-value=12
    data V2: type=float32, init-value=3.4
  application sw component type SWC1
    provide port Pport1: provided-interface=SRI1
  application sw component type SWC2
    require port Rport1: required-interface=SRI1
