AUTOSAR XML (schema 00046)
package /Lidar_Example
  sender receiver interface Lidar_SRI: is-service=0
    data Lidar_ObjectDistance: type=uint16, init-value=0
    data Lidar_ObjectID: type=uint16, init-value=0
    data Lidar_ObjectAngle: type=uint32, init-value=0
  sensor actuator sw component type Lidar_Sensor
    provide port Lidar_Provider_Port: provided-interface=Lidar_SRI
  application sw component type Lidar_Algo
    require port Lidar_Requester_Port: required-interface=Lidar_SRI
