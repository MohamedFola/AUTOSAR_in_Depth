AUTOSAR XML (schema 00046)
package /INTERFACES
  sender receiver interface LidarSensor
    data LidarData: type=float32
